#include <zephyr/dt-bindings/pinctrl/nrf-pinctrl.h>

/*
 * Tenstar Robot ProMicro nRF52840 / nice!nano v2 header route:
 * SCK D3/P0.20, MOSI D2/P0.17. The ST7735 is write-only, so the
 * configured D14/P1.11 MISO route is deliberately left unconnected.
 */
&spi2_default {
	group1 {
		psels = <NRF_PSEL(SPIM_SCK, 0, 20)>,
			<NRF_PSEL(SPIM_MOSI, 0, 17)>,
			<NRF_PSEL(SPIM_MISO, 1, 11)>;
	};
};

&spi2_sleep {
	group1 {
		psels = <NRF_PSEL(SPIM_SCK, 0, 20)>,
			<NRF_PSEL(SPIM_MOSI, 0, 17)>,
			<NRF_PSEL(SPIM_MISO, 1, 11)>;
		low-power-enable;
	};
};
